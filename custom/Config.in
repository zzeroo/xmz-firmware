## custom/package/xmz/Config.in
```kconfig
config BR2_PACKAGE_XMZ
  bool "xMZ"
  help
    xMZ basics

    https://zzeroo.com/xmz

if BR2_PACKAGE_XMZ
  source "$BR2_EXTERNAL_XMZ_PATH/package/xmz-config/Config.in"
  source "$BR2_EXTERNAL_XMZ_PATH/package/xmz-server/Config.in"
  source "$BR2_EXTERNAL_XMZ_PATH/package/xmz-test-tool/Config.in"
  source "$BR2_EXTERNAL_XMZ_PATH/package/xmz-weston-config/Config.in"
endif
```

## custom/package/xmz_test_tool/Config.in
```kconfig
comment "xMZ-Test-Tool depends on libgtk"
  depends on !BR2_PACKAGE_LIBGTK3

config BR2_PACKAGE_XMZ_TEST_TOOL
  bool "xMZ-Test Tool"
  depends on BR2_PACKAGE_LIBGTK3
  help
    xMZ Test Tool

    https://zzeroo.com/xmz

if BR2_PACKAGE_XMZ
source "$BR2_EXTERNAL_XMZ_PATH/package/xmz_test_tool_init_systemd/Config.in"
endif
```

## custom/package/xmz_test_tool_init_systemd/Config.in
```kconfig
comment "xmz-test-tool unit files depends on xmz_test_tool, systemd and weston"
  depends on !BR2_PACKAGE_XMZ_TEST_TOOL || !BR2_PACKAGE_WESTON || !BR2_INIT_SYSTEMD

config BR2_PACKAGE_XMZ_TEST_TOOL_INIT_SYSTEMD
  bool "systemd unit files for xMZ-Test Tool"
  depends on BR2_PACKAGE_XMZ_TEST_TOOL
  depends on BR2_PACKAGE_WESTON
  depends on BR2_INIT_SYSTEMD
  help
    xMZ Test Tool

    https://zzeroo.com/xmz
```

## custom/package/xmz_weston_config/Config.in
```kconfig
comment "weston-config depends on udev, systemd and weston."
  depends on !BR2_PACKAGE_HAS_UDEV || !BR2_INIT_SYSTEMD || !BR2_PACKAGE_WESTON

config BR2_PACKAGE_XMZ_WESTON_CONFIG
	bool "Weston config"
	depends on  BR2_INIT_SYSTEMD
	depends on BR2_PACKAGE_WESTON
	depends on BR2_INIT_SYSTEMD
	help
		Weston configuration.

		This configuration files provides touchscreen support and wallpapers for
		the weston installation.

		https://zzeroo.com/xmz

if BR2_PACKAGE_XMZ_WESTON_CONFIG
config BR2_PACKAGE_XMZ_WESTON_CONFIG_WALLPAPER_RA_GAS
	bool "Wallpaper RA-GAS GmbH"

	help
		Wallpaper with logo of RA-GAS GmbH Kernen i.R.
endif
```
