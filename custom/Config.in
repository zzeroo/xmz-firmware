## custom/Config.in
```kconfig
source "$BR2_EXTERNAL_XMZ_PATH/package/xmz/Config.in"

source "$BR2_EXTERNAL_XMZ_PATH/package/resize-rootfs/Config.in"
```

## custom/configs/homeserver_bananapro_defconfig
```kconfig
BR2_arm=y
BR2_cortex_a7=y
BR2_ARM_FPU_NEON_VFPV4=y
BR2_DL_DIR="$(TOPDIR)/../download"
BR2_CCACHE=y
BR2_CCACHE_DIR="$(TOPDIR)/../cache"
BR2_GLOBAL_PATCH_DIR="board/lemaker/bananapro/patches $(TOPDIR)/../custom/board/lemaker/bananapro/patches"
BR2_TOOLCHAIN_BUILDROOT_GLIBC=y
BR2_PACKAGE_GLIBC_UTILS=y
BR2_BINUTILS_VERSION_2_33_X=y
BR2_TOOLCHAIN_BUILDROOT_CXX=y
BR2_TOOLCHAIN_GLIBC_GCONV_LIBS_COPY=y
BR2_TARGET_GENERIC_HOSTNAME="homeserver-vanilla"
BR2_TARGET_GENERIC_ISSUE="Homeserver by 'zzeroo systems' on Banana Pro!"
BR2_INIT_SYSTEMD=y
BR2_SYSTEM_BIN_SH_ZSH=y
BR2_TARGET_GENERIC_GETTY_PORT="ttyS0"
BR2_SYSTEM_DEFAULT_PATH="/bin:/sbin:/usr/bin:/usr/sbin"
BR2_ENABLE_LOCALE_WHITELIST="C en_US de_DE"
BR2_GENERATE_LOCALE="en_US de_DE"
BR2_SYSTEM_ENABLE_NLS=y
BR2_TARGET_LOCALTIME="Europe/Berlin"
BR2_ROOTFS_USERS_TABLES="$(TOPDIR)/../custom/board/lemaker/bananapro/zzeroo.usertables"
BR2_ROOTFS_OVERLAY="$(TOPDIR)/../custom/board/lemaker/bananapro/rootfs_overlay"
BR2_ROOTFS_POST_BUILD_SCRIPT="$(TOPDIR)/../custom/board/lemaker/bananapro/post-build.sh"
BR2_ROOTFS_POST_IMAGE_SCRIPT="$(TOPDIR)/../custom/board/lemaker/bananapro/post-image.sh"
BR2_LINUX_KERNEL=y
BR2_LINUX_KERNEL_PATCH="$(TOPDIR)/../custom/board/lemaker/bananapro/patches/"
BR2_LINUX_KERNEL_DEFCONFIG="sunxi"
BR2_LINUX_KERNEL_CONFIG_FRAGMENT_FILES="board/lemaker/bananapro/linux-wifi.fragment $(TOPDIR)/../custom/board/lemaker/bananapro/linux-bananapro.fragment"
BR2_LINUX_KERNEL_DTS_SUPPORT=y
BR2_LINUX_KERNEL_INTREE_DTS_NAME="sun7i-a20-bananapro"
BR2_LINUX_KERNEL_INSTALL_TARGET=y
BR2_LINUX_KERNEL_NEEDS_HOST_OPENSSL=y
BR2_PACKAGE_LINUX_TOOLS_CPUPOWER=y
BR2_PACKAGE_LINUX_TOOLS_GPIO=y
BR2_PACKAGE_ALSA_UTILS=y
# BR2_PACKAGE_ALSA_UTILS_ALSAMIXER is not set
BR2_PACKAGE_ALSA_UTILS_AMIXER=y
BR2_PACKAGE_ALSA_UTILS_APLAY=y
BR2_PACKAGE_FLAC=y
BR2_PACKAGE_LAME=y
BR2_PACKAGE_PULSEAUDIO=y
BR2_PACKAGE_BZIP2=y
BR2_PACKAGE_GZIP=y
BR2_PACKAGE_P7ZIP=y
BR2_PACKAGE_UNRAR=y
BR2_PACKAGE_UNZIP=y
BR2_PACKAGE_XZ=y
BR2_PACKAGE_ZIP=y
BR2_PACKAGE_ZSTD=y
BR2_PACKAGE_GIT_CRYPT=y
BR2_PACKAGE_GREP=y
BR2_PACKAGE_MAKE=y
BR2_PACKAGE_PATCH=y
BR2_PACKAGE_SED=y
BR2_PACKAGE_TREE=y
BR2_PACKAGE_BTRFS_PROGS=y
BR2_PACKAGE_BITSTREAM_VERA=y
BR2_PACKAGE_MESA3D=y
BR2_PACKAGE_MESA3D_GALLIUM_DRIVER_LIMA=y
BR2_PACKAGE_MESA3D_GALLIUM_DRIVER_PANFROST=y
BR2_PACKAGE_MESA3D_OPENGL_EGL=y
BR2_PACKAGE_MESA3D_OPENGL_ES=y
BR2_PACKAGE_WESTON=y
BR2_PACKAGE_WESTON_DRM=y
BR2_PACKAGE_WESTON_RDP=y
BR2_PACKAGE_WESTON_X11=y
BR2_PACKAGE_WESTON_XWAYLAND=y
BR2_PACKAGE_WESTON_DEMO_CLIENTS=y
BR2_PACKAGE_XORG7=y
BR2_PACKAGE_LINUX_FIRMWARE=y
BR2_PACKAGE_LINUX_FIRMWARE_BRCM_BCM43XXX=y
BR2_PACKAGE_NODEJS=y
BR2_PACKAGE_NODEJS_NPM=y
BR2_PACKAGE_NODEJS_MODULES_ADDITIONAL="node-red node-red-dashboard pm2"
BR2_PACKAGE_LIBCDIO=y
BR2_PACKAGE_LIBMODPLUG=y
BR2_PACKAGE_LIBSAMPLERATE=y
BR2_PACKAGE_LIBSIDPLAY2=y
BR2_PACKAGE_LIBVORBIS=y
BR2_PACKAGE_TAGLIB=y
BR2_PACKAGE_LIBZIP=y
BR2_PACKAGE_LZ4=y
BR2_PACKAGE_SNAPPY=y
BR2_PACKAGE_SZIP=y
BR2_PACKAGE_BEARSSL=y
BR2_PACKAGE_CA_CERTIFICATES=y
BR2_PACKAGE_GNUTLS=y
BR2_PACKAGE_GNUTLS_OPENSSL=y
BR2_PACKAGE_GNUTLS_TOOLS=y
BR2_PACKAGE_LIBSODIUM=y
BR2_PACKAGE_LIBSSH2=y
BR2_PACKAGE_MBEDTLS=y
BR2_PACKAGE_MBEDTLS_PROGRAMS=y
BR2_PACKAGE_MBEDTLS_COMPRESSION=y
BR2_PACKAGE_LIBOPENSSL_BIN=y
BR2_PACKAGE_LIBOPENSSL_ENGINES=y
BR2_PACKAGE_BERKELEYDB=y
BR2_PACKAGE_SQLITE=y
BR2_PACKAGE_LIBNFS=y
BR2_PACKAGE_LIBGTK3=y
BR2_PACKAGE_LIBGTK3_DEMO=y
BR2_PACKAGE_LIBGTK3_TESTS=y
BR2_PACKAGE_LIBVA=y
BR2_PACKAGE_WAYLANDPP=y
BR2_PACKAGE_LIBCEC=y
BR2_PACKAGE_JSON_FOR_MODERN_CPP=y
BR2_PACKAGE_JSONCPP=y
BR2_PACKAGE_RAPIDJSON=y
BR2_PACKAGE_RAPIDXML=y
BR2_PACKAGE_TINYXML=y
BR2_PACKAGE_LIBASS=y
BR2_PACKAGE_LIBCURL=y
BR2_PACKAGE_LIBCURL_CURL=y
BR2_PACKAGE_LIBCURL_GNUTLS=y
BR2_PACKAGE_LIBMICROHTTPD=y
BR2_PACKAGE_RTMPDUMP=y
BR2_PACKAGE_FLATBUFFERS=y
BR2_PACKAGE_LIBCROSSGUID=y
BR2_PACKAGE_LIBPLIST=y
BR2_PACKAGE_FMT=y
BR2_PACKAGE_FSTRCMP=y
BR2_PACKAGE_NCURSES_WCHAR=y
BR2_PACKAGE_AVAHI=y
BR2_PACKAGE_AVAHI_DAEMON=y
BR2_PACKAGE_BIND_TOOLS=y
BR2_PACKAGE_BLUEZ5_UTILS=y
BR2_PACKAGE_BRIDGE_UTILS=y
BR2_PACKAGE_DHCP=y
BR2_PACKAGE_DHCP_CLIENT=y
BR2_PACKAGE_DNSMASQ=y
BR2_PACKAGE_ETHTOOL=y
BR2_PACKAGE_IPUTILS=y
BR2_PACKAGE_IW=y
BR2_PACKAGE_MOSQUITTO=y
BR2_PACKAGE_NET_TOOLS=y
BR2_PACKAGE_NETCAT_OPENBSD=y
BR2_PACKAGE_NFTABLES=y
BR2_PACKAGE_NTP=y
BR2_PACKAGE_NTP_SNTP=y
BR2_PACKAGE_OPENSSH=y
BR2_PACKAGE_RSYNC=y
BR2_PACKAGE_TRACEROUTE=y
BR2_PACKAGE_WGET=y
BR2_PACKAGE_WHOIS=y
BR2_PACKAGE_WIREGUARD_TOOLS=y
BR2_PACKAGE_WPA_SUPPLICANT=y
BR2_PACKAGE_WPA_SUPPLICANT_CLI=y
BR2_PACKAGE_WPA_SUPPLICANT_PASSPHRASE=y
BR2_PACKAGE_BASH=y
BR2_PACKAGE_BASH_COMPLETION=y
BR2_PACKAGE_FILE=y
BR2_PACKAGE_SUDO=y
BR2_PACKAGE_TMUX=y
BR2_PACKAGE_HTOP=y
BR2_PACKAGE_SYSTEMD_BACKLIGHT=y
BR2_PACKAGE_SYSTEMD_FIRSTBOOT=y
# BR2_PACKAGE_SYSTEMD_RESOLVED is not set
BR2_PACKAGE_TAR=y
BR2_PACKAGE_UTIL_LINUX_BINARIES=y
BR2_PACKAGE_UTIL_LINUX_NOLOGIN=y
BR2_PACKAGE_LESS=y
BR2_PACKAGE_VIM=y
BR2_TARGET_ROOTFS_BTRFS=y
BR2_TARGET_ROOTFS_BTRFS_SIZE="2G"
# BR2_TARGET_ROOTFS_TAR is not set
BR2_TARGET_UBOOT=y
BR2_TARGET_UBOOT_PATCH="$(TOPDIR)/../custom/board/lemaker/bananapro/patches/u-boot/"
BR2_TARGET_UBOOT_BOARD_DEFCONFIG="Bananapro"
BR2_TARGET_UBOOT_CONFIG_FRAGMENT_FILES="$(TOPDIR)/../custom/board/lemaker/bananapro/uboot-LCD.fragment"
BR2_TARGET_UBOOT_NEEDS_DTC=y
BR2_TARGET_UBOOT_NEEDS_PYLIBFDT=y
BR2_TARGET_UBOOT_SPL=y
BR2_TARGET_UBOOT_SPL_NAME="u-boot-sunxi-with-spl.bin"
BR2_PACKAGE_HOST_DOSFSTOOLS=y
BR2_PACKAGE_HOST_E2FSPROGS=y
BR2_PACKAGE_HOST_GENIMAGE=y
BR2_PACKAGE_HOST_MTOOLS=y
BR2_PACKAGE_HOST_RUSTC=y
BR2_PACKAGE_HOST_UBOOT_TOOLS=y
BR2_PACKAGE_XMZ=y
BR2_PACKAGE_XMZ_CONFIG=y
XMZ_CONFIG_WLAN=y
BR2_PACKAGE_XMZ_WESTON_CONFIG=y
BR2_PACKAGE_XMZ_WESTON_INIT_SYSTEMD=y
BR2_PACKAGE_RESIZE_ROOTFS=y
```

## custom/configs/xmz_bananapro_development_defconfig
```kconfig
BR2_arm=y
BR2_cortex_a7=y
BR2_ARM_FPU_NEON_VFPV4=y
BR2_DL_DIR="$(TOPDIR)/../download"
BR2_CCACHE=y
BR2_CCACHE_DIR="$(TOPDIR)/../cache"
BR2_GLOBAL_PATCH_DIR="board/lemaker/bananapro/patches $(TOPDIR)/../custom/board/lemaker/bananapro/patches"
BR2_TOOLCHAIN_BUILDROOT_GLIBC=y
BR2_PACKAGE_GLIBC_UTILS=y
BR2_TOOLCHAIN_BUILDROOT_CXX=y
BR2_TARGET_GENERIC_HOSTNAME="bananapro"
BR2_TARGET_GENERIC_ISSUE="Welcome to Banana Pro!"
BR2_INIT_SYSTEMD=y
BR2_TARGET_GENERIC_GETTY_PORT="ttyS0"
BR2_ROOTFS_OVERLAY="$(TOPDIR)/../custom/board/lemaker/bananapro/rootfs_overlay"
BR2_ROOTFS_POST_BUILD_SCRIPT="$(TOPDIR)/../custom/board/lemaker/bananapro/post-build.sh"
BR2_ROOTFS_POST_IMAGE_SCRIPT="$(TOPDIR)/../custom/board/lemaker/bananapro/post-image.sh"
BR2_LINUX_KERNEL=y
BR2_LINUX_KERNEL_PATCH="$(TOPDIR)/../custom/board/lemaker/bananapro/patches/"
BR2_LINUX_KERNEL_DEFCONFIG="sunxi"
BR2_LINUX_KERNEL_CONFIG_FRAGMENT_FILES="board/lemaker/bananapro/linux-wifi.fragment $(TOPDIR)/../custom/board/lemaker/bananapro/linux-bananapro.fragment"
BR2_LINUX_KERNEL_DTS_SUPPORT=y
BR2_LINUX_KERNEL_INTREE_DTS_NAME="sun7i-a20-bananapro"
BR2_LINUX_KERNEL_INSTALL_TARGET=y
BR2_LINUX_KERNEL_NEEDS_HOST_OPENSSL=y
BR2_PACKAGE_ALSA_UTILS=y
# BR2_PACKAGE_ALSA_UTILS_ALSAMIXER is not set
BR2_PACKAGE_ALSA_UTILS_AMIXER=y
BR2_PACKAGE_ALSA_UTILS_APLAY=y
BR2_PACKAGE_BTRFS_PROGS=y
BR2_PACKAGE_MESA3D=y
BR2_PACKAGE_MESA3D_GALLIUM_DRIVER_LIMA=y
BR2_PACKAGE_MESA3D_OPENGL_EGL=y
BR2_PACKAGE_MESA3D_OPENGL_ES=y
BR2_PACKAGE_WESTON=y
BR2_PACKAGE_LINUX_FIRMWARE=y
BR2_PACKAGE_LINUX_FIRMWARE_BRCM_BCM43XXX=y
BR2_PACKAGE_LIBGTK3=y
BR2_PACKAGE_NCURSES_WCHAR=y
BR2_PACKAGE_BIND_TOOLS=y
BR2_PACKAGE_BRIDGE_UTILS=y
BR2_PACKAGE_DHCP=y
BR2_PACKAGE_DHCP_CLIENT=y
BR2_PACKAGE_DNSMASQ=y
BR2_PACKAGE_ETHTOOL=y
BR2_PACKAGE_IPUTILS=y
BR2_PACKAGE_IW=y
BR2_PACKAGE_NET_TOOLS=y
BR2_PACKAGE_NETCAT_OPENBSD=y
BR2_PACKAGE_NFTABLES=y
BR2_PACKAGE_OPENSSH=y
BR2_PACKAGE_TRACEROUTE=y
BR2_PACKAGE_WGET=y
BR2_PACKAGE_WHOIS=y
BR2_PACKAGE_WIREGUARD_TOOLS=y
BR2_PACKAGE_WPA_SUPPLICANT=y
BR2_PACKAGE_WPA_SUPPLICANT_CLI=y
BR2_PACKAGE_WPA_SUPPLICANT_PASSPHRASE=y
BR2_PACKAGE_SYSTEMD_JOURNAL_GATEWAY=y
# BR2_PACKAGE_SYSTEMD_NETWORKD is not set
# BR2_PACKAGE_SYSTEMD_RESOLVED is not set
BR2_PACKAGE_LESS=y
BR2_PACKAGE_VIM=y
BR2_TARGET_ROOTFS_BTRFS=y
BR2_TARGET_ROOTFS_BTRFS_SIZE="512M"
# BR2_TARGET_ROOTFS_TAR is not set
BR2_TARGET_UBOOT=y
BR2_TARGET_UBOOT_PATCH="$(TOPDIR)/../custom/board/lemaker/bananapro/patches/u-boot/"
BR2_TARGET_UBOOT_BOARD_DEFCONFIG="Bananapro"
BR2_TARGET_UBOOT_CONFIG_FRAGMENT_FILES="$(TOPDIR)/../custom/board/lemaker/bananapro/uboot-LCD.fragment"
BR2_TARGET_UBOOT_NEEDS_DTC=y
BR2_TARGET_UBOOT_NEEDS_PYLIBFDT=y
BR2_TARGET_UBOOT_SPL=y
BR2_TARGET_UBOOT_SPL_NAME="u-boot-sunxi-with-spl.bin"
BR2_PACKAGE_HOST_DOSFSTOOLS=y
BR2_PACKAGE_HOST_E2FSPROGS=y
BR2_PACKAGE_HOST_GENIMAGE=y
BR2_PACKAGE_HOST_MTOOLS=y
BR2_PACKAGE_HOST_UBOOT_TOOLS=y
BR2_PACKAGE_XMZ=y
BR2_PACKAGE_XMZ_CONFIG=y
XMZ_CONFIG_WLAN=y
BR2_PACKAGE_XMZ_WESTON_CONFIG=y
BR2_PACKAGE_XMZ_WESTON_INIT_SYSTEMD=y
```

## custom/configs/xmz_bananapro_master_defconfig
```kconfig
BR2_arm=y
BR2_cortex_a7=y
BR2_ARM_FPU_NEON_VFPV4=y
BR2_DL_DIR="../download"
BR2_CCACHE=y
BR2_CCACHE_DIR="../cache"
BR2_TOOLCHAIN_BUILDROOT_GLIBC=y
BR2_PACKAGE_HOST_LINUX_HEADERS_CUSTOM_4_14=y
BR2_TOOLCHAIN_BUILDROOT_CXX=y
BR2_TARGET_GENERIC_HOSTNAME="bananapro"
BR2_TARGET_GENERIC_ISSUE="Welcome to Banana Pro!"
BR2_INIT_SYSTEMD=y
BR2_TARGET_GENERIC_GETTY_PORT="ttyS0"
BR2_ROOTFS_OVERLAY="../custom/board/lemaker/bananapro/rootfs_overlay"
BR2_ROOTFS_POST_BUILD_SCRIPT="../custom/board/lemaker/bananapro/post-build.sh"
BR2_ROOTFS_POST_IMAGE_SCRIPT="../custom/board/lemaker/bananapro/post-image.sh"
BR2_LINUX_KERNEL=y
BR2_LINUX_KERNEL_CUSTOM_GIT=y
BR2_LINUX_KERNEL_CUSTOM_REPO_URL="git://git.kernel.org/pub/scm/linux/kernel/git/torvalds/linux.git"
BR2_LINUX_KERNEL_CUSTOM_REPO_VERSION="v4.14"
BR2_LINUX_KERNEL_PATCH="../custom/board/lemaker/bananapro/patches/linux"
BR2_LINUX_KERNEL_DEFCONFIG="sunxi"
BR2_LINUX_KERNEL_CONFIG_FRAGMENT_FILES="board/lemaker/bananapro/linux-wifi.fragment ../custom/board/lemaker/bananapro/linux-TOUCHSCREEN.fragment ../custom/board/lemaker/bananapro/linux-USB_SERIAL.fragment"
BR2_LINUX_KERNEL_DTS_SUPPORT=y
BR2_LINUX_KERNEL_INTREE_DTS_NAME="sun7i-a20-bananapro"
BR2_LINUX_KERNEL_INSTALL_TARGET=y
BR2_PACKAGE_ALSA_UTILS=y
# BR2_PACKAGE_ALSA_UTILS_ALSAMIXER is not set
BR2_PACKAGE_ALSA_UTILS_AMIXER=y
BR2_PACKAGE_ALSA_UTILS_APLAY=y
BR2_PACKAGE_DEJAVU=y
BR2_PACKAGE_ADWAITA_ICON_THEME=y
BR2_PACKAGE_HICOLOR_ICON_THEME=y
BR2_PACKAGE_MESA3D=y
BR2_PACKAGE_MESA3D_DRI_DRIVER_SWRAST=y
BR2_PACKAGE_MESA3D_OPENGL_EGL=y
BR2_PACKAGE_MESA3D_OPENGL_ES=y
BR2_PACKAGE_WESTON=y
BR2_PACKAGE_WESTON_DRM=y
BR2_PACKAGE_WESTON_FBDEV=y
BR2_PACKAGE_WESTON_X11=y
BR2_PACKAGE_WESTON_XWAYLAND=y
BR2_PACKAGE_XORG7=y
BR2_PACKAGE_LINUX_FIRMWARE=y
BR2_PACKAGE_LINUX_FIRMWARE_BRCM_BCM43XXX=y
BR2_PACKAGE_LIBGTK3=y
# BR2_PACKAGE_LIBGTK3_BROADWAY is not set
BR2_PACKAGE_SHARED_MIME_INFO=y
BR2_PACKAGE_IW=y
BR2_PACKAGE_WPA_SUPPLICANT=y
BR2_PACKAGE_WPA_SUPPLICANT_CLI=y
BR2_PACKAGE_WPA_SUPPLICANT_PASSPHRASE=y
# BR2_PACKAGE_SYSTEMD_VCONSOLE is not set
BR2_TARGET_ROOTFS_EXT2=y
BR2_TARGET_ROOTFS_EXT2_4=y
BR2_TARGET_ROOTFS_EXT2_SIZE="200M"
# BR2_TARGET_ROOTFS_TAR is not set
BR2_TARGET_UBOOT=y
BR2_TARGET_UBOOT_BUILD_SYSTEM_KCONFIG=y
BR2_TARGET_UBOOT_CUSTOM_GIT=y
BR2_TARGET_UBOOT_CUSTOM_REPO_URL="https://github.com/u-boot/u-boot.git"
BR2_TARGET_UBOOT_CUSTOM_REPO_VERSION="v2018.11"
BR2_TARGET_UBOOT_BOARD_DEFCONFIG="Bananapro"
BR2_TARGET_UBOOT_CONFIG_FRAGMENT_FILES="../custom/board/lemaker/bananapro/uboot-LCD.fragment"
BR2_TARGET_UBOOT_NEEDS_DTC=y
BR2_TARGET_UBOOT_NEEDS_PYLIBFDT=y
BR2_TARGET_UBOOT_SPL=y
BR2_TARGET_UBOOT_SPL_NAME="u-boot-sunxi-with-spl.bin"
BR2_PACKAGE_HOST_DOSFSTOOLS=y
BR2_PACKAGE_HOST_GENIMAGE=y
BR2_PACKAGE_HOST_MTOOLS=y
BR2_PACKAGE_HOST_UBOOT_TOOLS=y
BR2_PACKAGE_XMZ=y
BR2_PACKAGE_XMZ_SERVER=y
BR2_PACKAGE_XMZ_TEST_TOOL_INIT_SYSTEMD=y
BR2_PACKAGE_XMZ_TEST_TOOL=y
BR2_PACKAGE_XMZ_WESTON_INIT_SYSTEMD=y
BR2_PACKAGE_XMZ_WESTON_CONFIG=y
BR2_PACKAGE_XMZ_WESTON_CONFIG_WALLPAPER_RA_GAS=y
```

## custom/package/resize-rootfs/Config.in
```kconfig
config BR2_PACKAGE_RESIZE_ROOTFS
  bool "Resize the root filesystem"
  depends on BR2_INIT_SYSTEMD
  select BR2_PACKAGE_E2FSPROGS
  select BR2_PACKAGE_E2FSPROGS_RESIZE2FS
  select BR2_PACKAGE_GPTFDISK
  select BR2_PACKAGE_GPTFDISK_GDISK
  select BR2_PACKAGE_GPTFDISK_SGDISK
  select BR2_PACKAGE_PARTED

  help
    Resize root filesystem to fit available disk space

    https://zzeroo.com/xmz
```

## custom/package/rust-package/Config.in
```kconfig
comment "Rust package dependes on rustc"
  depends on !BR2_PACKAGE_RUSTC

config BR2_PACKAGE_RUST_PACKAGE
  bool "Rust package"
  depends on BR2_PACKAGE_RUSTC
  help
    A tool to test a rust package.

    https://zzeroo.com/
```

## custom/package/xmz-config/Config.in
```kconfig
config BR2_PACKAGE_XMZ_CONFIG
  bool "xMZ Configuration"
  help
    Additional configuration of the 'xMZ' platform

    https://zzeroo.com/xmz

if BR2_PACKAGE_XMZ_CONFIG

  comment "xmz-config-wlan depends on the wpa_supplicant"
    depends on !BR2_PACKAGE_WPA_SUPPLICANT

  config XMZ_CONFIG_WLAN
  bool "xmz-config-wlan"
  help
    wpa_supplicant and network config.

endif
```

## custom/package/xmz-server/Config.in
```kconfig
config BR2_PACKAGE_XMZ_SERVER
  bool "xmz-server"
  help
    Server of the xMZ platform

    https://zzeroo.com/xmz
```

## custom/package/xmz-test-tool-init-systemd/Config.in
```kconfig
comment "xmz-test-tool systemd unit file depends on the xmz-test-tool"
  depends on !BR2_PACKAGE_XMZ_TEST_TOOL

config BR2_PACKAGE_XMZ_TEST_TOOL_INIT_SYSTEMD
  bool "systemd unit files for xmz-test-tool"
  depends on BR2_PACKAGE_XMZ_TEST_TOOL
  help
    Unit files for systemd to control the xmz-test-tool.

    https://zzeroo.com/xmz-test-tool
```

## custom/package/xmz-test-tool/Config.in
```kconfig
comment "xMZ-Test-Tool depends on libgtk"
  depends on !BR2_PACKAGE_LIBGTK3

config BR2_PACKAGE_XMZ_TEST_TOOL
  bool "xmz-test-tool"
  depends on BR2_PACKAGE_LIBGTK3
  help
    A tool to test many aspects of the xMZ platform.

    https://zzeroo.com/xmz

if BR2_PACKAGE_XMZ
source "$BR2_EXTERNAL_XMZ_PATH/package/xmz-test-tool-init-systemd/Config.in"
endif
```

## custom/package/xmz-weston-config/Config.in
```kconfig
comment "weston-config depends on udev, systemd and weston."
  depends on !BR2_PACKAGE_HAS_UDEV || !BR2_INIT_SYSTEMD || !BR2_PACKAGE_WESTON

config BR2_PACKAGE_XMZ_WESTON_CONFIG
	bool "Weston configuration"
	depends on  BR2_INIT_SYSTEMD
	depends on BR2_PACKAGE_WESTON
	depends on BR2_INIT_SYSTEMD
	help
		Weston configuration.

		This configuration files provides touchscreen support and wallpapers for
		a weston installation on the target.

		https://zzeroo.com/xmz


if BR2_PACKAGE_XMZ_WESTON_CONFIG
  source "$BR2_EXTERNAL_XMZ_PATH/package/xmz-weston-init-systemd/Config.in"

choice
  prompt "Weston Wallpaper"
  default BR2_PACKAGE_XMZ_WESTON_CONFIG_WALLPAPER_ZZEROO
  help
    Select a wallpaper for weston

config BR2_PACKAGE_XMZ_WESTON_CONFIG_WALLPAPER_ZZEROO
	bool "Wallpaper 'zzeroo systems'"

	help
		Wallpaper with logo of the 'zzeroo systems'.

config BR2_PACKAGE_XMZ_WESTON_CONFIG_WALLPAPER_RA_GAS
	bool "Wallpaper RA-GAS GmbH"

	help
		Wallpaper with logo of the 'RA-GAS GmbH Kernen i.R.'

endchoice

endif
```

## custom/package/xmz-weston-init-systemd/Config.in
```kconfig
comment "The systemd unit files for weston depends on systemd and weston of course."
  depends on !BR2_PACKAGE_WESTON || !BR2_INIT_SYSTEMD

config BR2_PACKAGE_XMZ_WESTON_INIT_SYSTEMD
  bool "Weston systemd unit file"
  depends on BR2_PACKAGE_WESTON
  depends on BR2_INIT_SYSTEMD
  help
    Initalizes a basic weston session on tty1.

    https://zzeroo.com/xmz
```
